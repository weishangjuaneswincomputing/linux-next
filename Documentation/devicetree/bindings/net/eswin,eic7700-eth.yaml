## Documentation/devicetree/bindings/net/eswin,eic7700-eth.yaml
```yaml
# SPDX-License-Identifier: (GPL-2.0-only OR BSD-2-Clause)
%YAML 1.2
---
$id: http://devicetree.org/schemas/net/eswin,eic7700-eth.yaml#
$schema: http://devicetree.org/meta-schemas/core.yaml#

title: Eswin EIC7700 SOC Eth Controller

maintainers:
  - weishangjuan <weishangjuan@eswincomputing.com>

description: |
  The eth controller registers are part of the syscrg block on
  the EIC7700 SoC.

properties:
  compatible:
    const: eswin,eic7700-qos-eth

  reg:
    minItems: 1
    items:
      - description: Base address and size
      - description: Extension region (optional)

  numa-node-id:
    $ref: /schemas/types.yaml#/definitions/uint32

  interrupt-names:
    const: macirq

  interrupts:
    maxItems: 1

  phy-mode:
    $ref: /schemas/types.yaml#/definitions/string
    enum: [mii, gmii, rgmii, rmii, sgmii]

  id:
    $ref: /schemas/types.yaml#/definitions/uint32
    description: Controller instance ID

  clocks:
    minItems: 3
    maxItems: 7

  clock-names:
    minItems: 3
    items:
      - const: app
      - const: stmmaceth
      - const: tx
      - const: slave_bus
      - const: master_bus
      - const: ptp_ref
      - const: phy_ref_clk

  resets:
    maxItems: 1

  reset-names:
    items:
      - const: ethrst

  dma-noncoherent: true

  # Custom properties
  eswin,hsp_sp_csr:
    $ref: /schemas/types.yaml#/definitions/phandle-array
    description: HSP SP control registers

  eswin,syscrg_csr:
    $ref: /schemas/types.yaml#/definitions/phandle-array
    description: System clock registers

  eswin,dly_hsp_reg:
    $ref: /schemas/types.yaml#/definitions/uint32-array
    description: HSP delay control registers

  snps,axi-config:
    $ref: /schemas/types.yaml#/definitions/phandle
    description: AXI bus configuration

  stmmac-axi-config:
    type: object
    unevaluatedProperties: false
    properties:
      snps,lpi_en:
        type: boolean
        # $ref: /schemas/types.yaml#/definitions/flag
        description: Low Power Interface enable flag (true/false)

required:
  - compatible
  - reg
  - numa-node-id
  - interrupt-names
  - interrupts
  - phy-mode
  - id
  - clocks
  - clock-names
  - resets
  - reset-names
  - eswin,hsp_sp_csr
  - eswin,syscrg_csr
  - eswin,dly_hsp_reg
  - snps,axi-config
  - snps,blen
  - snps,rd_osr_lmt
  - snps,wr_osr_lmt
  - snps,lpi_en

additionalProperties: false

examples:
  - |
    d0_gmac0: ethernet@50400000 {
        compatible = "eswin,eic7700-qos-eth";
        reg = <0x0 0x50400000 0x0 0x10000>;
        interrupt-parent = <&plic0>;
        interrupt-names = "macirq";
        interrupts = <61>;
        phy-mode = "rgmii";
        numa-node-id = <0>;
        id = <0>;
        status = "disabled";
        clocks = <&d0_clock 550>,
                 <&d0_clock 551>,
                 <&d0_clock 552>;
        clock-names = "app", "stmmaceth", "tx";
        resets = <&d0_reset 0x07 (1 << 26)>;
        reset-names = "ethrst";
        dma-noncoherent;
        eswin,hsp_sp_csr = <&d0_hsp_sp_csr 0x1030 0x100 0x108>;
        eswin,syscrg_csr = <&d0_sys_crg 0x148 0x14c>;
        eswin,dly_hsp_reg = <0x114 0x118 0x11c>;
        snps,axi-config = <&d0_stmmac_axi_setup>;
        d0_stmmac_axi_setup: stmmac-axi-config {
            snps,blen = <0 0 0 0 16 8 4>;
            snps,rd_osr_lmt = <2>;
            snps,wr_osr_lmt = <2>;
            snps,lpi_en;
        };
    };
```
